## boards/libresolar/mppt_1210_hus/board.yml
```yaml
board:
  name: mppt_1210_hus
  full_name: Libre Solar MPPT 1210 HUS
  vendor: libresolar
  socs:
    - name: stm32l072xx
  revision:
    format: major.minor.patch
    default: "0.7.0"
    revisions:
      - name: "0.4.0"
      - name: "0.7.0"
```

## boards/libresolar/mppt_2420_hpx/board.yml
```yaml
board:
  name: mppt_2420_hpx
  full_name: Libre Solar MPPT 2420 HPX
  vendor: libresolar
  socs:
    - name: stm32g431xx
```

## boards/libresolar/mppt_2420_lc/board.yml
```yaml
board:
  name: mppt_2420_lc
  full_name: Libre Solar MPPT 2420 LC
  vendor: libresolar
  socs:
    - name: stm32f072xb
```

## boards/libresolar/mppt_2420_rc/board.yml
```yaml
board:
  name: mppt_2420_rc
  full_name: Libre Solar MPPT 2420 RC
  vendor: libresolar
  socs:
    - name: stm32f072xb
```

## boards/libresolar/pwm_2420_lus/board.yml
```yaml
board:
  name: pwm_2420_lus
  full_name: Libre Solar PWM 2420 LUS
  vendor: libresolar
  socs:
    - name: stm32l072xx
  revision:
    format: major.minor.patch
    default: "0.3.0"
    revisions:
      - name: "0.2.0"
      - name: "0.3.0"
```
